## Docs/blue/sdkconfig.defaults
```kconfig
# Target: original ESP32 / ESP32-WROOM family
CONFIG_ESPTOOLPY_FLASHSIZE_4MB=y
CONFIG_BT_ENABLED=y
# Match ESP_BT_MODE_CLASSIC_BT used by bluetooth_init().
CONFIG_BTDM_CTRL_MODE_BR_EDR_ONLY=y
CONFIG_BT_BLUEDROID_ENABLED=y
CONFIG_BT_CLASSIC_ENABLED=y
# CONFIG_BT_BLE_ENABLED is not set
CONFIG_BT_HID_ENABLED=y
CONFIG_BT_HID_HOST_ENABLED=y
CONFIG_PARTITION_TABLE_SINGLE_APP_LARGE=y
CONFIG_HTTPD_MAX_REQ_HDR_LEN=1024
```
